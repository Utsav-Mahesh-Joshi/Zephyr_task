## modules/my_console/Kconfig
```kconfig
#create a new symbol my_console

config MY_CONSOLE
	bool "basic print commands to console"
	depends on PRINTK #printk should be enabled for this to work
	help
		Adds my_console() function to enable printing and logging on the device
```

## modules/my_hd44780_pcf8574_mod/Kconfig
```kconfig
#menu "HD44780 over PCF8574"


#rsource "drivers/hd44780_pcf8574/Kconfig"



#config HD44780_PCF8574
#	bool "HD44780 LCD via PCF8574 I2C backpack"
#	select I2C
#	help
#	  Enable a simple HD44780 LCD driver that talks to the LCD
#	  through a PCF8574 8-bit I2C I/O expander.

#endmenu

rsource "drivers/Kconfig"
```

## modules/my_hd44780_pcf8574_mod/drivers/hd44780_pcf8574/Kconfig
```kconfig
menu "HD44780 over PCF8574"

config HD44780_PCF8574
        bool "HD44780 LCD via PCF8574 I2C backpack"
        select I2C
        help
          Enable a simple HD44780 LCD driver that talks to the LCD
          through a PCF8574 8-bit I2C I/O expander.

endmenu



if HD44780_PCF8574

config HD44780_PCF8574_INIT_PRIORITY
	int "Init priority"
	default 80
	help
	  Device init priority for the LCD driver.

config HD44780_PCF8574_DEFAULT_COLS
	int "Default columns"
	default 16
	range 8 40

config HD44780_PCF8574_DEFAULT_ROWS
	int "Default rows"
	default 2
	range 1 4

config HD44780_PCF8574_BACKLIGHT_ON_BOOT
	bool "Backlight on at boot"
	default y

endif
```

## modules/my_hd44780_pcf8574_mod/dts/bindings/display/hit,hd44780-pcf8574.yaml
```yaml
title: HIT HD44780 LCD via PCF8574 I2C backpack

description: >
  Character LCD compatible with HD44780 controller, connected through
  a PCF8574 I2C 8-bit expander (4-bit mode wiring).
  Bit map defaults: P0=RS, P1=RW, P2=E, P3=BL, P4..P7=D4..D7.

compatible: "hit,hd44780-pcf8574"

include: i2c-device.yaml

properties:
  columns:
    type: int
    required: false
    description: Number of columns (characters per row).
    default: 16

  rows:
    type: int
    required: false
    description: Number of rows.
    default: 2

  bl-active-low:
    type: boolean
    required: false
    description: Backlight control line is active-low on the backpack.
```
