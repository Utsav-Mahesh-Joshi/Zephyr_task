## CMakeLists.txt
```
cmake_minimum_required(VERSION 3.20.0)
find_package(Zephyr REQUIRED HINTS $ENV{ZEPHYR_BASE})
project(buttonled)
target_sources(app PRIVATE src/main.c src/my_console.c)
include_directories(include)
```

## prj.conf
```kconfig
CONFIG_GPIO=y
#CONFIG_SERIAL=y
#CONFIG_CONSOLE=y
#CONFIG_UART_CONSOLE=y
```

## boards/disco_l475_iot1.conf
```kconfig
CONFIG_SERIAL=y
CONFIG_CONSOLE=y
CONFIG_UART_CONSOLE=y
```

## src/main.c
```c
#include <zephyr/kernel.h>
#include <zephyr/drivers/gpio.h>
#include "my_console.h"
//#include <zephyr/logging/log.h>

//LOG_MODULE_REGISTER(main);

/** 
 * @brief LED device tree specification.
 */
static const struct gpio_dt_spec led = GPIO_DT_SPEC_GET(DT_ALIAS(led0), gpios);

/** 
 * @brief Button device tree specification.
 */
static const struct gpio_dt_spec button = GPIO_DT_SPEC_GET(DT_ALIAS(sw0), gpios);

/**
 * @brief Callback structure for button interrupt.
 */
static struct gpio_callback button_cb_data;

/**
 * @brief Current LED state.
 * 
 * `true` if LED is ON, `false` if LED is OFF.
 */
static bool led_state = false;

/**
 * @brief Button press interrupt handler.
 *
 * This function is called whenever the button is pressed.  
 * It toggles the LED state (ON/OFF) and logs the state using
 * `my_console_print()` or `my_console_printf()`.
 *
 * @param dev Pointer to the device structure for the button.
 * @param cb  Pointer to the callback structure.
 * @param pins Bitmask of pins that triggered the interrupt.
 *
 * @return void
 */
void button_pressed(const struct device *dev, struct gpio_callback *cb, uint32_t pins)
{
	if (led_state) {
		gpio_pin_set_dt(&led, 0);
		led_state = false;
		my_console_print("LED OFF");
	} else {
		gpio_pin_set_dt(&led, 1);
		my_console_printf("LED ON at %d pin\n", led.pin);
		led_state = true;
	}
}

/**
 * @brief Main entry point of the application.
 *
 * Initializes the LED and button GPIOs, configures the button
 * for interrupt-on-press, and registers a callback.  
 * The application then enters an infinite loop where it simply 
 * sleeps, waiting for button events.
 *
 * @retval 0 Application executed successfully (though in Zephyr bare-metal apps, this is not used).
 */
int main(void)
{
	if (!device_is_ready(led.port)) {
		my_console_print("led failed");
		return 0;
	}

	gpio_pin_configure_dt(&led, GPIO_OUTPUT_INACTIVE);

	if (!device_is_ready(button.port)) {
		my_console_print("button failed");
		return 0;
	}

	gpio_pin_configure_dt(&button, GPIO_INPUT);
	gpio_pin_interrupt_configure_dt(&button, GPIO_INT_EDGE_TO_ACTIVE);

	gpio_init_callback(&button_cb_data, button_pressed, BIT(button.pin));
	gpio_add_callback(button.port, &button_cb_data);

	while (1)
	{
		k_msleep(100);
	}
}
```

## include/my_console.h
```c
#ifndef MY_CONSOLE_H
#define MY_CONSOLE_H

#include <stdio.h>
#include <zephyr/kernel.h>
#include <zephyr/sys/printk.h>

/**
 * @file my_console.h
 * @brief Console printing utility functions for Zephyr.
 *
 * This module provides simple wrapper functions for printing messages
 * to the console using printk. It offers both basic string output
 * and formatted printing similar to printf.
 */

/**
 * @brief Print a message to the console.
 *
 * Wrapper around Zephyr's printk to output a string without formatting.
 *
 * @param msg Pointer to the null-terminated string message.
 *
 * @return void
 */
void my_console_print(const char *msg);

/**
 * @brief Print a formatted message to the console.
 *
 * Wrapper around Zephyr's printk to output formatted text
 * using printf-style formatting.
 *
 * @param fmt Format string (printf-style).
 * @param ... Variable arguments for the format string.
 *
 * @return void
 */
void my_console_printf(const char *fmt, ...);

#endif /* MY_CONSOLE_H */
```

## src/my_console.c
```c
#include <stdarg.h>
#include "my_console.h"

/**
 * @brief Print a simple message to the console.
 *
 * This function wraps Zephyr's printk to print a string followed
 * by a newline. It is useful for quick debugging messages.
 *
 * @param msg Pointer to the null-terminated string message.
 *
 * @return void
 */
void my_console_print(const char *msg)
{
	printk("%s\n", msg);
}

/**
 * @brief Print a formatted message to the console.
 *
 * This function provides printf-style formatted output. It uses
 * Zephyr's vprintf internally to handle variable arguments.
 *
 * @param fmt Format string (printf-style).
 * @param ... Variable arguments for the format string.
 *
 * @return void
 */
void my_console_printf(const char *fmt, ...)
{
	va_list args;
	va_start(args, fmt);
	vprintf(fmt, args);
	va_end(args);
}
```
