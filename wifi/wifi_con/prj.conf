## CMakeLists.txt
```
cmake_minimum_required(VERSION 3.20.0)

find_package(Zephyr REQUIRED HINTS $ENV{ZEPHYR_BASE})

project(wifi_con)
include_directories(include)
include_directories(/home/uj/zephyrproject/zephyr/drivers/wifi/eswifi)
#target_sources(app PRIVATE src/main.c src/wifi.c )
target_sources(app PRIVATE src/main.c src/ping.c src/http_get.c)
```

## prj.conf
```kconfig
CONFIG_WIFI=y
CONFIG_INIT_STACKS=y
CONFIG_NET_L2_WIFI_MGMT=y

CONFIG_LOG=y

CONFIG_NETWORKING=y

CONFIG_NET_SHELL=y
CONFIG_NET_IPV4=y
CONFIG_NET_UDP=y
CONFIG_NET_TCP=y
CONFIG_DNS_RESOLVER=y
CONFIG_DNS_RESOLVER_AI_MAX_ENTRIES=10

CONFIG_NET_SOCKETS=y
CONFIG_HTTP_CLIENT=y
CONFIG_NET_SOCKETS_OFFLOAD=y
CONFIG_NET_OFFLOAD=y


CONFIG_NET_DHCPV4=y

CONFIG_NET_CONFIG_SETTINGS=y

CONFIG_NET_L2_ETHERNET=y

CONFIG_MAIN_STACK_SIZE=4096
CONFIG_HEAP_MEM_POOL_SIZE=6144

#CONFIG_LOG_DEFAULT_LEVEL=4
```

## src/main.c
```c
#include <zephyr/kernel.h>
#include <zephyr/net/net_if.h>
#include <zephyr/net/net_mgmt.h>
#include <zephyr/net/wifi_mgmt.h>
#include <zephyr/net/wifi_utils.h>
#include <zephyr/net/net_ip.h>
#include <zephyr/logging/log.h>
#include <zephyr/sys/printk.h>

#include <zephyr/net/net_event.h>
#include "ping.h"
#include "http_get.h"
LOG_MODULE_REGISTER(wifi_demo);

/* ---- SET THESE or pass via Kconfig/overlay/env ---- */
#define WIFI_SSID      "Utsav"
#define WIFI_PASSWORD  "utsav12345"
#define WIFI_SECURITY  WIFI_SECURITY_TYPE_PSK  /* WPA2-PSK (AES) */
#define WIFI_TIMEOUT_MS 15000                  /* per attempt */

static struct net_mgmt_event_callback wifi_cb;
static struct net_mgmt_event_callback ipv4_cb;
/* Track state so main thread can wait */
static K_SEM_DEFINE(conn_sem, 0, 1);
static K_SEM_DEFINE(ipv4_sem, 0, 1);

static void wifi_event_handler(struct net_mgmt_event_callback *cb,
                               uint64_t mgmt_event, struct net_if *iface)
{
	switch (mgmt_event) 
	{
		case NET_EVENT_WIFI_CONNECT_RESULT: 
			const struct wifi_status *st = (const struct wifi_status *) cb->info;
			LOG_INF("WiFi connect result: %d", st ? st->status : -1);
			if(st->status)
			{
				LOG_INF("Connection request failed (%d)", st->status);
			}
			else
			{
				LOG_INF("Connected");
				k_sem_give(&conn_sem);
			}
			break;

		case NET_EVENT_WIFI_DISCONNECT_RESULT:
			const struct wifi_status *status = (const struct wifi_status*)cb->info;
			if(status->status)
			{
				LOG_INF("Disconnect request %d",status->status);
			}
			else
			{
				LOG_INF("WiFi disconnected");
				k_sem_take(&conn_sem,K_NO_WAIT);
			}
			break;

		case NET_EVENT_IPV4_ADDR_ADD:
			int32_t i = 0;

			for (i = 0; i < NET_IF_MAX_IPV4_ADDR; i++)
			{

				char buf[NET_IPV4_ADDR_LEN];

				if (iface->config.ip.ipv4->unicast[i].ipv4.addr_type != NET_ADDR_DHCP) 
					continue;

				LOG_INF("IPv4 address: %s",
						net_addr_ntop(AF_INET,
							&iface->config.ip.ipv4->unicast[i].ipv4.address.in_addr,
							buf, sizeof(buf)));
				LOG_INF("Subnet: %s",
						net_addr_ntop(AF_INET,
							&iface->config.ip.ipv4->unicast[i].netmask,
							buf, sizeof(buf)));
				LOG_INF("Router: %s",
						net_addr_ntop(AF_INET,
							&iface->config.ip.ipv4->gw,
							buf, sizeof(buf)));
			}
			LOG_INF("Got IPv4 address");
			k_sem_give(&ipv4_sem);
			break;

		default:
			break;
	}
}

static int do_wifi_scan(struct net_if *iface)
{
    LOG_INF("Starting WiFi scan...");
    int ret = net_mgmt(NET_REQUEST_WIFI_SCAN, iface, NULL, 0);
    if (ret) {
        LOG_WRN("wifi scan request failed: %d", ret);
    }
    /* Optional: you can register NET_EVENT_WIFI_SCAN_RESULT / DONE to print results */
    return ret;
}

static int wifi_connect()
{
	//struct net_if *iface = net_if_get_wifi_sta();
	struct net_if *iface = net_if_get_default();
    struct wifi_connect_req_params params = {
        .ssid = WIFI_SSID,
        .ssid_length = strlen(WIFI_SSID),
        .psk = WIFI_PASSWORD,
        .psk_length = strlen(WIFI_PASSWORD),
        .security = WIFI_SECURITY,
        .channel = WIFI_CHANNEL_ANY,
        .mfp = WIFI_MFP_OPTIONAL,
	.band=WIFI_FREQ_BAND_2_4_GHZ,
    };

    int ret = net_mgmt(NET_REQUEST_WIFI_CONNECT, iface, &params, sizeof(params));
    LOG_INF("wifi connect requested: SSID=\"%s\"", params.ssid);
    if (ret) 
    {
        LOG_ERR("net_mgmt CONNECT failed: %d", ret);
        return ret;
    }
    return 0;
}
void wifi_status()
{

	struct net_if *iface = net_if_get_default();
	//struct net_if *iface =net_if_get_wifi_sta();
	struct wifi_iface_status status = {0};
	if (net_mgmt(NET_REQUEST_WIFI_IFACE_STATUS, iface, &status,sizeof(struct wifi_iface_status)))
   	{
        	LOG_INF("WiFi Status Request Failed");
    	}

	if(status.state >= WIFI_STATE_ASSOCIATED)
	{
		LOG_INF("SSID: %-32s",status.ssid);
		LOG_INF("Band: %s",wifi_band_txt(status.band));
		LOG_INF("Channel: %d",status.channel);
		LOG_INF("Security:%s",wifi_security_txt(status.security));
		LOG_INF("RSSI:%d",status.rssi);
	}

}

void wifi_disconnect()
{
	//struct net_if *iface =net_if_get_wifi_sta();
	struct net_if *iface = net_if_get_default();
	if(net_mgmt(NET_REQUEST_WIFI_DISCONNECT,iface,NULL,0))
	{
		LOG_INF("Wifi Disconnection failed");
	}

}
int main(void)
{
	int sock;
	printk("chik chik \r\n");
	LOG_INF("Wifi Example \r\nBoard:%s",CONFIG_BOARD);
	net_mgmt_init_event_callback(&wifi_cb,wifi_event_handler,
			NET_EVENT_WIFI_CONNECT_RESULT|NET_EVENT_WIFI_DISCONNECT_RESULT);

	net_mgmt_init_event_callback(&ipv4_cb,wifi_event_handler,NET_EVENT_IPV4_ADDR_ADD);
	
	printk("chik chik on net_mgmt\r\n");
	net_mgmt_add_event_callback(&wifi_cb);
	net_mgmt_add_event_callback(&ipv4_cb);

	wifi_connect();

	k_sem_take(&conn_sem,K_FOREVER);

	wifi_status(&ipv4_sem,K_FOREVER);
	ping("8.8.8.8",4);

	LOG_INF("Looking up IP address");
	struct zsock_addrinfo *res;
	//nslookup("example.com",&res);
	nslookup("io.adafruit.com",&res);
//	nslookup("portainer.happyjoy.in",&res);
	print_addrinfo_results(&res);

	LOG_INF("Connecting to HTTP Server:");
    	sock = connect_socket(&res, 80);
	k_msleep(10);
    	http_get(sock, "example.com", "http://example.com/");
	k_msleep(10);
    	zsock_close(sock);
}
```

## include/http_get.h
```c
#ifndef HTTP_GET_H
#define HTTP_GET_H

#include <stdio.h>
#include <stdlib.h>
#include <zephyr/net/socket.h>

void nslookup(const char * hostname, struct zsock_addrinfo **results);
void print_addrinfo_results(struct zsock_addrinfo **results);
void http_get(int sock, char * hostname, char * url);
int connect_socket(struct zsock_addrinfo **results, uint16_t port);

#endif
```

## include/ping.h
```c
#ifndef PING_H
#define PING_H

void ping(char* ipv4_addr, uint8_t count);

#endif
```

## src/http_get.c
```c
#include <stdio.h>
#include <stdlib.h>
#include <zephyr/net/socket.h>
#include <zephyr/kernel.h>
#include <zephyr/net/http/client.h>
#include "http_get.h"

LOG_MODULE_REGISTER(http);
void nslookup(const char * hostname, struct zsock_addrinfo **results)
{
	int err;
	
	struct zsock_addrinfo hints = {
		.ai_family = AF_INET,     // Allow IPv4 Address
		//.ai_family = AF_UNSPEC,		// Allow IPv4 or IPv6	
		.ai_socktype = SOCK_STREAM,
	};

	err = zsock_getaddrinfo(hostname, NULL, &hints, (struct zsock_addrinfo **) results);
	if (err) 
	{
		//printf("getaddrinfo() failed, err %d\n", errno);
		printf("getaddrinfo() failed, err %d\n", err);
		return;
	}
}

void print_addrinfo_results(struct zsock_addrinfo **results)
{
	char ipv4[INET_ADDRSTRLEN];
//	char ipv6[INET6_ADDRSTRLEN];
	struct sockaddr_in *sa;
//	struct sockaddr_in6 *sa6;
	struct zsock_addrinfo *rp;

	for (rp = *results; rp != NULL; rp = rp->ai_next)
       	{
		if (rp->ai_addr->sa_family == AF_INET)
	       	{
			// IPv4 Address
			sa = (struct sockaddr_in *) rp->ai_addr;
			zsock_inet_ntop(AF_INET, &sa->sin_addr, ipv4, INET_ADDRSTRLEN);
			LOG_INF("IPv4: %s", ipv4);
		}
	}
}

int connect_socket(struct zsock_addrinfo **results, uint16_t port)
{
	int sock;
	int ret;
	struct zsock_addrinfo *rp;

	struct sockaddr_in *sa;

	// Create IPv4 Socket
	sock = zsock_socket(AF_INET, SOCK_STREAM, IPPROTO_TCP);
	if (sock < 0) {
		printk("Error creating IPv4 socket\n");
		return(-1);
	}

	// Iterate through IPv4 addresses until we get a successful connection
	for (rp = *results; rp != NULL; rp = rp->ai_next)
       	{
		if (rp->ai_addr->sa_family == AF_INET) 
		{
			// IPv4 Address
			sa = (struct sockaddr_in *) rp->ai_addr;
			sa->sin_port = htons(port);

			char ipv4[INET_ADDRSTRLEN];
			zsock_inet_ntop(AF_INET, &sa->sin_addr, ipv4, INET_ADDRSTRLEN);
			printk("Connecting to %s:%d ", ipv4, port);

			ret = zsock_connect(sock, (struct sockaddr *) sa, sizeof(struct sockaddr_in));
			if (ret == 0)
		       	{
				printk("Success\r\n");
				return(sock);
			}
		       	else
		       	{
				printk("Failure (%d)\r\n", ret);
			}
		}
	}

	return(0);
}

static void http_response_cb(struct http_response *rsp,
			enum http_final_call final_data,
			void *user_data)
{
	if (final_data == HTTP_DATA_MORE) 
	{
		//printk("Partial data received (%zd bytes)\n", rsp->data_len);
	}
       	else if (final_data == HTTP_DATA_FINAL) 
	{
		//printk("All the data received (%zd bytes)\n", rsp->data_len);
	}

	//printk("Bytes Recv %zd\n", rsp->data_len);
	//printk("Response status %s\n", rsp->http_status);
	//printk("Recv Buffer Length %zd\n", rsp->recv_buf_len);
	printk("%.*s", rsp->data_len, rsp->recv_buf);
}


void http_get(int sock, char * hostname, char * url)
{
	struct http_request req = { 0 };
	static uint8_t recv_buf[512];
	int ret;

	req.method = HTTP_GET;
	req.url = url;
	req.host = hostname;
	req.protocol = "HTTP/1.1";
	req.response = (void *)http_response_cb;
	req.recv_buf = recv_buf;
	req.recv_buf_len = sizeof(recv_buf);

	ret = http_client_req(sock, &req, 5000, NULL);
}
```

## src/ping.c
```c
/*#include <zephyr/kernel.h>
#include <zephyr/logging/log.h>
#include <zephyr/net/socket.h>
#include <zephyr/net/net_ip.h>
#include <zephyr/sys/printk.h>

LOG_MODULE_REGISTER(ping_sock);

#define PING_TIMEOUT_MS	 2000
#define PING_DATA_SIZE	 32
#define PING_INTERVAL_MS 2000

void ping(const char* host,uint8_t count)
{
	int sock;
	struct sockaddr_in addr;

	char send_buf[PING_DATA_SIZE];
	char recv_buf[64];
	int ret;
	int i;

	memset(&addr,0,sizeof(addr));
	addr.sin_family=AF_INET;
	addr.sin_port=0;

	ret=zsock_inet_pton(AF_INET,host,&addr.sin_addr);
	if(ret <= 0)
	{
		LOG_ERR("Invalid IP address: %s",host);
		return;
	}

	sock=zsock_socket(AF_INET,SOCK_RAW,IPPROTO_ICMP);
	if(sock<0)
	{
		LOG_ERR("Unable to create ICMP socket, err=%d",sock);
		return;
	}

	struct timeval timeout={
		.tv_sec=PING_TIMEOUT_MS /1000,
		.tv_usec=(PING_TIMEOUT_MS%1000)*1000
	};

	zsock_setsockopt(sock,SOL_SOCKET,SO_RCVTIMEO,&timeout,sizeof(timeout));

	for(int i=0;i<count;i++)
	{
		memset(send_buf,0,sizeof(send_buf));
		strcpy(send_buf,"zephyr-ping");
		uint32_t start_time = k_uptime_get_32();
		ret=zsock_sendto(sock,send_buf,sizeof(send_buf),0,
				(struct sockaddr*)&addr,sizeof(addr));
		if(ret<0)
		{
			LOG_ERR("Send failed %d ",ret);
		}

		ret=zsock_recv(sock,recv_buf,sizeof(recv_buf),0);
		if(ret)
		{
			LOG_WRN("Request Timeout");
		}
		else
		{
			uint32_t elapsed = k_uptime_get_32()-start_time;
			LOG_INF("Reply from %s : bytes %d time=%ds",host,ret,elapsed);
		}

		k_msleep(PING_INTERVAL_MS);
	}
	zsock_close(sock);



}
*/

#include <zephyr/kernel.h>
#include <zephyr/device.h>
//#include <zephyr/drivers/wifi/eswifi/eswifi.h>
#include "eswifi.h"
#include <zephyr/logging/log.h>
LOG_MODULE_REGISTER(ping_at, LOG_LEVEL_INF);

void eswifi_send_at_ping(const char *ip)
{
    //const struct device *dev = DEVICE_DT_GET_ONE(ism43362);
    //const struct device *dev = DEVICE_DT_GET(wifi0)
    const struct device *dev = DEVICE_DT_GET(DT_ALIAS(eswifi0));
    if (!device_is_ready(dev)) {
        LOG_ERR("esWiFi device not ready");
        return;
    }

    struct eswifi_dev *eswifi = dev->data;
    char cmd[32];
    snprintf(cmd, sizeof(cmd), "T1=%s\r", ip);

    k_mutex_lock(&eswifi->mutex, K_FOREVER);
    int ret = eswifi_request(eswifi, cmd, strlen(cmd), eswifi->buf, sizeof(eswifi->buf));
    snprintf(cmd, sizeof(cmd), "T0\r");
    ret = eswifi_request(eswifi, cmd, strlen(cmd), eswifi->buf, sizeof(eswifi->buf));

    k_mutex_unlock(&eswifi->mutex);

    if (ret > 0) {
        LOG_INF("PING response: %s", eswifi->buf);
    } else {
        LOG_ERR("PING failed, ret=%d", ret);
    }
}
void ping(const char *ip,uint8_t count)
{
	for(uint8_t i=0;i<count;i++)
	{
		eswifi_send_at_ping(ip);
		k_msleep(100);
	}
}
```

## src/wifi.c
```c
#include <string.h>
#include <zephyr/kernel.h>
#include <zephyr/net/wifi_mgmt.h>

// Event callbacks
static struct net_mgmt_event_callback wifi_cb;
static struct net_mgmt_event_callback ipv4_cb;

// Semaphores
static K_SEM_DEFINE(sem_wifi, 0, 1);
static K_SEM_DEFINE(sem_ipv4, 0, 1);

// Called when the WiFi is connected
static void on_wifi_connection_event(struct net_mgmt_event_callback *cb,
                                     uint32_t mgmt_event,
                                     struct net_if *iface)
{
    const struct wifi_status *status = (const struct wifi_status *)cb->info;

    if (mgmt_event == NET_EVENT_WIFI_CONNECT_RESULT) {
        if (status->status) {
            printk("Error (%d): Connection request failed\r\n", status->status);
        } else {
            printk("Connected!\r\n");
            k_sem_give(&sem_wifi);
        }
    } else if (mgmt_event == NET_EVENT_WIFI_DISCONNECT_RESULT) {
        if (status->status) {
            printk("Error (%d): Disconnection request failed\r\n", status->status);
        } else {
            printk("Disconnected\r\n");
            k_sem_take(&sem_wifi, K_NO_WAIT);
        }
    }
}

// Event handler for WiFi management events
static void on_ipv4_obtained(struct net_mgmt_event_callback *cb,
                             uint32_t mgmt_event,
                             struct net_if *iface)
{
    // Signal that the IP address has been obtained
    if (mgmt_event == NET_EVENT_IPV4_ADDR_ADD) {
        k_sem_give(&sem_ipv4);
    }
}

// Initialize the WiFi event callbacks
void wifi_init(void)
{
    // Initialize the event callbacks
    net_mgmt_init_event_callback(&wifi_cb,
                                 on_wifi_connection_event,
                                 NET_EVENT_WIFI_CONNECT_RESULT | NET_EVENT_WIFI_DISCONNECT_RESULT);
    net_mgmt_init_event_callback(&ipv4_cb,
                                 on_ipv4_obtained,
                                 NET_EVENT_IPV4_ADDR_ADD);
    
    // Add the event callbacks
    net_mgmt_add_event_callback(&wifi_cb);
    net_mgmt_add_event_callback(&ipv4_cb);
}

// Connect to the WiFi network (blocking)
int wifi_connect(char *ssid, char *psk)
{
    int ret;
    struct net_if *iface;
    struct wifi_connect_req_params params;

    // Get the default networking interface
    iface = net_if_get_default();

    // Fill in the connection request parameters
    params.ssid = (const uint8_t *)ssid;
    params.ssid_length = strlen(ssid);
    params.psk = (const uint8_t *)psk;
    params.psk_length = strlen(psk);
    params.security = WIFI_SECURITY_TYPE_PSK;
    params.band = WIFI_FREQ_BAND_UNKNOWN;
    params.channel = WIFI_CHANNEL_ANY;
    params.mfp = WIFI_MFP_OPTIONAL;

    // Connect to the WiFi network
    ret = net_mgmt(NET_REQUEST_WIFI_CONNECT,
                   iface,
                   &params,
                   sizeof(params));

    // Wait for the connection to complete
    k_sem_take(&sem_wifi, K_FOREVER);

    return ret;
}

// Wait for IP address (blocking)
void wifi_wait_for_ip_addr(void)
{
    struct wifi_iface_status status;
    struct net_if *iface;
    char ip_addr[NET_IPV4_ADDR_LEN];
    char gw_addr[NET_IPV4_ADDR_LEN];

    // Get interface
    iface = net_if_get_default();

    // Wait for the IPv4 address to be obtained
    k_sem_take(&sem_ipv4, K_FOREVER);

    // Get the WiFi status
    if (net_mgmt(NET_REQUEST_WIFI_IFACE_STATUS,
                 iface,
                 &status,
                 sizeof(struct wifi_iface_status))) {
        printk("Error: WiFi status request failed\r\n");
    }

    // Get the IP address
    memset(ip_addr, 0, sizeof(ip_addr));
    if (net_addr_ntop(AF_INET,
                      &iface->config.ip.ipv4->unicast[0].ipv4.address.in_addr,
                      ip_addr,
                      sizeof(ip_addr)) == NULL) {
        printk("Error: Could not convert IP address to string\r\n");
    }

    // Get the gateway address
    memset(gw_addr, 0, sizeof(gw_addr));
    if (net_addr_ntop(AF_INET,
                      &iface->config.ip.ipv4->gw,
                      gw_addr,
                      sizeof(gw_addr)) == NULL) {
        printk("Error: Could not convert gateway address to string\r\n");
    }

    // Print the WiFi status
    printk("WiFi status:\r\n");
    if (status.state >= WIFI_STATE_ASSOCIATED) {
        printk("  SSID: %-32s\r\n", status.ssid);
        printk("  Band: %s\r\n", wifi_band_txt(status.band));
        printk("  Channel: %d\r\n", status.channel);
        printk("  Security: %s\r\n", wifi_security_txt(status.security));
        printk("  IP address: %s\r\n", ip_addr);
        printk("  Gateway: %s\r\n", gw_addr);
    }
}

// Disconnect from the WiFi network
int wifi_disconnect(void)
{
    int ret;
    struct net_if *iface = net_if_get_default();

    ret = net_mgmt(NET_REQUEST_WIFI_DISCONNECT, iface, NULL, 0);

    return ret;
}
```
